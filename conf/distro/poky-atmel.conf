## conf/distro/poky-atmel.conf
```bitbake
require conf/distro/poky.conf

DISTRO = "poky-atmel"

DISTRO_FEATURES:remove ?= "opengl wayland x11 3g nfc pulseaudio"

DISTRO_FEATURES:append = " pam systemd ppp"

# icu is needed for qtwebkit; update for QT6 if used
PACKAGECONFIG:pn-qtbase ?= "icu tslib openssl freetype fontconfig"

# Check if these are needed with QT6
ALLOW_EMPTY:qt3d-mkspecs = "1"
ALLOW_EMPTY:qt3d-qmlplugins = "1"
ALLOW_EMPTY:qtconnectivity-qmlplugins = "1"
ALLOW_EMPTY:qtgraphicaleffects-qmlplugins = "1"
ALLOW_EMPTY:qtlocation-qmlplugins = "1"
ALLOW_EMPTY:qtmultimedia-qmlplugins = "1"
ALLOW_EMPTY:qtsensors-qmlplugins = "1"
ALLOW_EMPTY:qtsystems-qmlplugins = "1"
ALLOW_EMPTY:qttools-plugins = "1"
ALLOW_EMPTY:qtwebchannel-qmlplugins = "1"
ALLOW_EMPTY:qtwebkit-qmlplugins = "1"
ALLOW_EMPTY:qtwebsockets-qmlplugins = "1"

EXTRA_OECONF:remove = "${DISABLE_STATIC}"
PREFERRED_VERSION_swig = "4.1.0%"

VIRTUAL-RUNTIME_syslog = "busybox-syslog"
```

## conf/layer.conf
```bitbake
BBPATH .= ":${LAYERDIR}"

BBFILES += "${LAYERDIR}/recipes*/*/*.bb ${LAYERDIR}/recipes*/*/*.bbappend"

BBFILE_COLLECTIONS += "meta-rba5d2x"
BBFILE_PATTERN_meta-rba5d2x := "^${LAYERDIR}/"
BBFILE_PRIORITY_meta-rba5d2x = "10"

LICENSE_PATH += "${LAYERDIR}/licenses"

BBFILES_DYNAMIC += " \
    qt5-layer:${LAYERDIR}/dynamic-layers/qt5-layer/*/*/*.bb \
    qt5-layer:${LAYERDIR}/dynamic-layers/qt5-layer/*/*/*.bbappend \
"

LAYERSERIES_COMPAT_meta-rba5d2x = "scarthgap"
```
